## firmware/components/ble/Kconfig.projbuild
```kconfig
menu "BLE Sniffer"

config BLE_CONN_ENABLED
    bool "Enable optional BLE connection feature (GATT client, F2.4)"
    default y
    depends on BT_NIMBLE_ENABLED
    select BT_NIMBLE_ROLE_CENTRAL
    help
        Adds the central-role connection feature: connect to one peer by
        advertised service UUID (auto-connect) or direct address, subscribe
        a notify/indicate characteristic (poll fallback), and re-stream the
        payloads as "src":"conn" JSON lines on the same USB stream.

        Disabled: ble_conn.c is excluded from the build, the CONN commands
        answer -451, and firmware behavior is byte-identical to the
        feature-less product.

endmenu
```

## firmware/components/lua/Kconfig.projbuild
```kconfig
menu "H6.1 Tool Registry"

config LUA_HW_BINDINGS
    bool "Expose hw.* bindings in the Lua sandbox"
    default y
    help
        H6.1 M3 device API for tool packs: hw.millis, hw.gpio_write,
        hw.gpio_read, hw.adc_read (ADC1), hw.kv_set / hw.kv_get (a
        device-owned key-value store under /littlefs/kv — the
        "configure" deploy-mode seam). Pins are whitelisted (USB,
        flash and PSRAM pins are excluded). Disable for a locked-down
        build; tool packs that wrap hw.* then degrade to clean error
        strings.

endmenu
```
